## hwtest/main/Kconfig.projbuild
```kconfig
menu "Hardware test"

    config HWTEST_LINES_PER_SEC
        int "Console lines printed per second"
        range 1 100
        default 1
        help
            1 for the normal hello-world check. Set 100 for the stage 2 console stress test.

endmenu
```
